## boards/shields/Kconfig.shield
```kconfig
config SHIELD_MULLOY42_LEFT
    def_bool $(shields_list_contains,mulloy42_left)

config SHIELD_MULLOY42_RIGHT
    def_bool $(shields_list_contains,mulloy42_right)
```

## config/boards/shileds/mulloy42/Kconfig.defconfig
```kconfig
if SHIELD_MULLOY42_LEFT

# Name must be less than 16 characters long!
config ZMK_KEYBOARD_NAME
    default "Mulloy42"

config ZMK_SPLIT_ROLE_CENTRAL
    default y

endif

if SHIELD_MULLOY42_LEFT || SHIELD_MULLOY42_RIGHT

config ZMK_SPLIT
    default y

endif
```

## config/boards/shileds/mulloy42/Kconfig.shield
```kconfig
# No whitespace after the comma or in your part name!
config MULLOY42_LEFT
    def_bool $(shields_list_contains,mulloy42_left)

# No whitespace after the comma or in your part name!
config MULLOY42_RIGHT
    def_bool $(shields_list_contains,mulloy42_right)
```

## boards/shields/mulloy42/Kconfig.shield
```kconfig
config MULLOY42_LEFT
    def_bool $(shields_list_contains,mulloy42_left)

config MULLOY42_RIGHT
    def_bool $(shields_list_contains,mulloy42_right)
```
